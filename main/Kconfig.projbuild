## main/Kconfig.projbuild
```kconfig
menu "dalangs_TFT"

    choice DALANGS_LCD_DRIVER
        prompt "LCD controller"
        default DALANGS_LCD_ILI9341
        help
            Select the controller on the 2.8 inch 240x320 SPI module.
            The red modules are often ILI9341; ST7789 modules are usually black.
            If colors are wrong or the image is shifted, try the other option.

        config DALANGS_LCD_ST7789
            bool "ST7789"

        config DALANGS_LCD_ILI9341
            bool "ILI9341"
    endchoice

    config DALANGS_LCD_INVERT_COLOR
        bool "Invert panel colors"
        default y
        help
            Most IPS 2.8 inch modules need color inversion. Disable if the
            image looks like a photographic negative.

    choice DALANGS_LCD_SPI_MODE
        prompt "LCD SPI mode"
        default DALANGS_LCD_SPI_MODE_0
        help
            ILI9341 supports mode 0 and 3. If the image is partial or noisy,
            try the other mode.

        config DALANGS_LCD_SPI_MODE_0
            bool "Mode 0"

        config DALANGS_LCD_SPI_MODE_3
            bool "Mode 3"
    endchoice

    config DALANGS_TOUCH_DEBUG
        bool "Log touch coordinates"
        default n
        help
            Logs raw and mapped touch coordinates while pressed. Use it to
            verify axis swap, mirror, and TOUCH_RAW_* calibration.

    config DALANGS_WASM_SMOKE_TEST
        bool "Load every wasm applet once at boot"
        default n
        help
            Loads all embedded applets in sequence and logs their load time
            and widget count before opening the normal UI.

    config DALANGS_CAMERA_ENABLE
        bool "Enable camera preview"
        default y
        help
            Disable to test the LVGL UI on a black background without
            initializing the camera. Useful when separating a display fault
            from a camera preview fault.

    config DALANGS_LCD_SELF_TEST
        bool "Loop full-screen colors at boot"
        default n
        help
            Fills the panel with red, green, blue, white, black, and gray,
            then repeats forever. Use this to separate a panel/wiring/power
            fault from an application fault. Disable to boot the UI.

endmenu
```
